## boards/shields/uniblock_arda/Kconfig.defconfig
```kconfig
if SHIELD_UNIBLOCK_ARDA

config ZMK_KEYBOARD_NAME
    default "uniblock_arda"

endif
```

## boards/shields/uniblock_arda/Kconfig.shield
```kconfig
config SHIELD_UNIBLOCK_ARDA
    def_bool $(shields_list_contains, uniblock_arda)
```
